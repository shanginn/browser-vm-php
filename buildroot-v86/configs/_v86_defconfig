## buildroot-v86/configs/_v86_defconfig
```kconfig
BR2_x86_pentiumpro=y
BR2_CCACHE=y
BR2_PACKAGE_HOST_LINUX_HEADERS_CUSTOM_4_19=y
BR2_TOOLCHAIN_BUILDROOT_WCHAR=y
BR2_ROOTFS_OVERLAY="$(BR2_EXTERNAL_v86_PATH)/board/v86/rootfs_overlay/"
BR2_ROOTFS_POST_IMAGE_SCRIPT="$(BR2_EXTERNAL_v86_PATH)/board/v86/post-image.sh"
BR2_LINUX_KERNEL=y
BR2_LINUX_KERNEL_CUSTOM_VERSION=y
BR2_LINUX_KERNEL_CUSTOM_VERSION_VALUE="4.19.172"
BR2_LINUX_KERNEL_USE_CUSTOM_CONFIG=y
BR2_LINUX_KERNEL_CUSTOM_CONFIG_FILE="$(BR2_EXTERNAL_v86_PATH)/board/v86/linux.config"
BR2_PACKAGE_NANO=y
BR2_TARGET_ROOTFS_INITRAMFS=y
BR2_TARGET_ROOTFS_ISO9660=y
BR2_TARGET_SYSLINUX=y
BR2_PACKAGE_BUSYBOX_SHOW_OTHERS=y
BR2_PACKAGE_LESS=y

# If you want to add the nled editor, uncomment NLED + NCURSES
#BR2_PACKAGE_NCURSES=y
#BR2_PACKAGE_NLED=y

# PHP

BR2_PACKAGE_PHP_ARCH_SUPPORTS=y
BR2_PACKAGE_PHP=y
BR2_PACKAGE_PHP_SAPI_CLI=y
BR2_PACKAGE_PHP_EXT_CALENDAR=y
BR2_PACKAGE_PHP_EXT_FILEINFO=y
BR2_PACKAGE_PHP_EXT_OPCACHE=y
BR2_PACKAGE_PHP_EXT_READLINE=y
BR2_PACKAGE_PHP_EXT_SESSION=y
BR2_PACKAGE_PHP_EXT_BZIP2=y
BR2_PACKAGE_PHP_EXT_PHAR=y
BR2_PACKAGE_PHP_EXT_ZIP=y
BR2_PACKAGE_PHP_EXT_ZLIB=y
BR2_PACKAGE_PHP_EXT_LIBARGON2=y
BR2_PACKAGE_PHP_EXT_LIBSODIUM=y
BR2_PACKAGE_PHP_EXT_OPENSSL=y
BR2_PACKAGE_PHP_EXT_DBA=y
BR2_PACKAGE_PHP_EXT_DBA_CDB=y
BR2_PACKAGE_PHP_EXT_DBA_DB4=y
BR2_PACKAGE_PHP_EXT_MYSQLI=y
BR2_PACKAGE_PHP_EXT_PGSQL=y
BR2_PACKAGE_PHP_EXT_SQLITE=y
BR2_PACKAGE_PHP_EXT_PDO=y
BR2_PACKAGE_PHP_EXT_PDO_MYSQL=y
BR2_PACKAGE_PHP_EXT_PDO_POSTGRESQL=y
BR2_PACKAGE_PHP_EXT_PDO_SQLITE=y
BR2_PACKAGE_PHP_EXT_PDO_UNIXODBC=y
BR2_PACKAGE_PHP_EXT_ICONV=y
BR2_PACKAGE_PHP_EXT_MBSTRING=y
BR2_PACKAGE_PHP_EXT_EXIF=y
BR2_PACKAGE_PHP_EXT_GD=y
BR2_PACKAGE_PHP_EXT_BCMATH=y
BR2_PACKAGE_PHP_EXT_GMP=y
BR2_PACKAGE_PHP_EXT_TOKENIZER=y
BR2_PACKAGE_PHP_EXT_CURL=y
BR2_PACKAGE_PHP_EXT_FTP=y
BR2_PACKAGE_PHP_EXT_SNMP=y
BR2_PACKAGE_PHP_EXT_SOCKETS=y
BR2_PACKAGE_PHP_EXT_PCNTL=y
BR2_PACKAGE_PHP_EXT_POSIX=y
BR2_PACKAGE_PHP_EXT_SHMOP=y
BR2_PACKAGE_PHP_EXT_SYSVMSG=y
BR2_PACKAGE_PHP_EXT_SYSVSEM=y
BR2_PACKAGE_PHP_EXT_SYSVSHM=y
BR2_PACKAGE_PHP_EXT_CTYPE=y
BR2_PACKAGE_PHP_EXT_FILTER=y
BR2_PACKAGE_PHP_EXT_SOAP=y
BR2_PACKAGE_PHP_EXT_DOM=y
BR2_PACKAGE_PHP_EXT_LIBXML2=y
BR2_PACKAGE_PHP_EXT_SIMPLEXML=y
BR2_PACKAGE_PHP_EXT_XML=y
BR2_PACKAGE_PHP_EXT_XMLREADER=y
BR2_PACKAGE_PHP_EXT_XMLWRITER=y
BR2_PACKAGE_PHP_EXT_XSL=y
BR2_PACKAGE_PHP_EXT_FFI=y
BR2_PACKAGE_PHP_EXT_JSON=y
```
